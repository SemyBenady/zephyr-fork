## drivers/gpio/Kconfig.drv8912
```kconfig
# Copyright (c) 2026 BayLibre SAS
# SPDX-License-Identifier: Apache-2.0

# DRV8912 GPIO configuration options

menuconfig GPIO_DRV8912
	bool "TI DRV8912-Q1 half-bridge driver"
	default y
	depends on DT_HAS_TI_DRV8912_GPIO_ENABLED && SPI
	help
	  Enable the TI DRV8912-Q1 automotive 12-channel half-bridge
	  driver, exposing every half-bridge output as a GPIO pin.

config GPIO_DRV8912_INIT_PRIORITY
	int "Driver init priority"
	default 99
	depends on GPIO_DRV8912
	help
	  Device driver initialization priority. It must be greater than
	  SPI_INIT_PRIORITY, as the device is on a SPI bus.
```

## dts/bindings/gpio/ti,drv8912-gpio.yaml
```yaml
# Copyright (c) 2026 BayLibre SAS
# SPDX-License-Identifier: Apache-2.0

description: |
  TI DRV8912-Q1 automotive 12-channel half-bridge driver.

  Every half-bridge is exposed as a GPIO pin, pin N driving the OUT(N+1) output
  of the device. Logic 1 turns the high-side switch on, which ties the output to
  the VM supply. Logic 0 turns the low-side switch on, which ties the output to
  ground. GPIO_DISCONNECTED turns both switches off, which leaves the output
  floating.

  The outputs are floating after reset, so a load wired between an output and
  either supply rail stays released until it is explicitly driven.

  The half-bridges are push-pull only. Inputs, pull-ups, pull-downs, open-drain
  and open-source configurations are rejected, as the device supports none of
  them.

compatible: "ti,drv8912-gpio"

include: [spi-device.yaml, gpio-controller.yaml]

properties:
  "#gpio-cells":
    const: 2

  ngpios:
    type: int
    required: true
    const: 12
    description: Number of half-bridges of the device.

  nsleep-gpios:
    type: phandle-array
    description: |
      Driver enable pin. The device sits in low power sleep mode and ignores the
      SPI bus while this pin is low. When the property is omitted the pin is
      assumed to be tied high on the board.

  nfault-gpios:
    type: phandle-array
    description: |
      Fault indication pin. This is an open-drain output, asserted by the device
      while at least one fault is latched, and it needs an external pull-up.

  overvoltage-protection-millivolt:
    type: int
    default: 21000
    enum:
      - 21000
      - 33000
    description: |
      Supply overvoltage protection threshold. The default matches the power on
      reset value of the device.

      A supply above 20 V requires the higher setting: the device otherwise
      disables every half-bridge, stops its charge pump and asserts the fault
      pin, all of which leaves the SPI bus working and the outputs dead.

gpio-cells:
  - pin
  - flags
```
